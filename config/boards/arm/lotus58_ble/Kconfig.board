## config/boards/arm/lotus58_ble/Kconfig.board
```kconfig
# SPDX-License-Identifier: MIT

config BOARD_LOTUS58_BLE_LEFT
       bool "Lotus58 BLE Left"
       depends on SOC_NRF52840_QIAA

config BOARD_LOTUS58_BLE_RIGHT
       bool "Lotus58 BLE Right"
       depends on SOC_NRF52840_QIAA
```

## config/boards/arm/lotus58_ble/Kconfig.defconfig
```kconfig
# SPDX-License-Identifier: MIT

if BOARD_LOTUS58_BLE_LEFT

config ZMK_KEYBOARD_NAME
    default "Lotus58 BLE"

config ZMK_SPLIT_ROLE_CENTRAL
    default y

endif # BOARD_LOTUS58_BLE_LEFT


if BOARD_LOTUS58_BLE_LEFT || BOARD_LOTUS58_BLE_RIGHT

config BOARD
    default "lotus58_ble"

config ZMK_SPLIT
    default y

config BT_CTLR
    default BT


if USB

config USB_NRFX
    default y

config USB_DEVICE_STACK
    default y

endif # USB

# Uncomment the ZMK_DISPLAY and LVGL stuff to use the nice!view
# display. It may need some adjustment to correctly match the Lotus58
# BLE's actual hardware.

# config ZMK_DISPLAY
#     select LV_USE_CONT
#     select LV_FONT_MONTSERRAT_26
#     select LV_FONT_MONTSERRAT_16
#     select LV_USE_LABEL
#     select LV_USE_IMG

# choice ZMK_DISPLAY_STATUS_SCREEN
#     default ZMK_DISPLAY_STATUS_SCREEN_CUSTOM
# endchoice

# if ZMK_DISPLAY

# config SPI
#     default y

# config SPI_NRFX
#     default y

# endif # ZMK_DISPLAY

# if LVGL

# config LV_Z_VDB_SIZE
#     default 64

# config LV_DPI_DEF
#     default 148

# config LV_Z_BITS_PER_PIXEL
#     default 1

# choice LV_COLOR_DEPTH
#     default LV_COLOR_DEPTH_1
# endchoice

# endif # LVGL

endif # BOARD_LOTUS58_BLE_LEFT || BOARD_LOTUS58_BLE_RIGHT
```

## config/boards/arm/lotus58_ble/lotus58_ble_right_defconfig
```kconfig
# SPDX-License-Identifier: MIT

CONFIG_SOC_SERIES_NRF52X=y
CONFIG_SOC_NRF52840_QIAA=y
CONFIG_BOARD_LOTUS58_BLE_LEFT=y

# Enable memory protection unit
CONFIG_ARM_MPU=y

# Enable pin control
CONFIG_PINCTRL=y

# Enable general purpose input/output
CONFIG_GPIO=y

# Uncomment these three lines to enable UART serial console.
# CONFIG_SERIAL=y
# CONFIG_CONSOLE=y
# CONFIG_UART_CONSOLE=y

CONFIG_USE_DT_CODE_PARTITION=y
CONFIG_BUILD_OUTPUT_UF2=y

# Enable writing to flash
CONFIG_MPU_ALLOW_FLASH_WRITE=y
CONFIG_NVS=y
CONFIG_SETTINGS_NVS=y
CONFIG_FLASH=y
CONFIG_FLASH_PAGE_LAYOUT=y
CONFIG_FLASH_MAP=y

# Enable Bluetooth
CONFIG_ZMK_BLE=y

# Enable universal serial bus
CONFIG_ZMK_USB=y
```
